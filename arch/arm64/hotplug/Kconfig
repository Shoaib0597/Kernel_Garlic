## arch/arm64/hotplug/Kconfig
```kconfig
config  POWER_PLUG
        bool "PowerPlug HotPlug, for big.LITTLE SoCs"
	default y
	help
		A Dynamic HotPlug (Based on State Helper Driver by 
		Pranav Vashi (@neobuddy89)) for Octa-Core big.LITTLE SoCs, 
		developed by Shoaib Anwar (@Shoaib0597).
```

## drivers/input/fingerprint/Kconfig
```kconfig
config TINNO_FINGERPRINT_SUPPORT
	bool "TINNO_FINGERPRINT_SUPPORT"
	help
	  Kernel space image fingerprint driver. 
```
